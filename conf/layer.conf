## conf/layer.conf
```bitbake
# Append conf and classes to BBPATH
BBPATH .= ":${LAYERDIR}"

# Add recipe dirs to BBFILES
BBFILES += "${LAYERDIR}/recipes-*/*/*.bb ${LAYERDIR}/recipes-*/*/*.bbappend"
BBFILES += "${LAYERDIR}/recipes-*/*.bb ${LAYERDIR}/recipes-*/*.bbappend"

BBFILE_COLLECTIONS += "buglabs-layer"
BBFILE_PATTERN_buglabs-layer := "^${LAYERDIR}/"
BBFILE_PRIORITY_buglabs-layer = "8"
```
